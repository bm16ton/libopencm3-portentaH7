## usb-spi-uart-i2c-adc-tft/usb-spi-uart/auto-overlay/Kconfig
```kconfig
# SPDX-License-Identifier: GPL-2.0-only
#
config DTBCFG
	tristate "dtbocfg"
	default y
	help
	  Support for the Cirrus Logic Madera platform audio codecs
```
